ASAP2_VERSION 1 41
/begin PROJECT MyCCF_PC3_PC "Generated by ETAS from Project MyCCF_PC3_PC"
/begin HEADER "" VERSION "000" PROJECT_NO ASD /end HEADER
/begin MODULE MyCCF_PC3_PC "Generated by ETAS ASCET7 from Project: MyCCF_PC3_PC"
/begin IF_DATA E_TARGET
 /begin SOURCE "Task0" 3 /* period */ 10 QP_BLOB 1 /end SOURCE
 /begin TP_BLOB /* programm id */ 2088777160 /* target id */ 7 0 2 0 /end TP_BLOB
/end IF_DATA
/begin MOD_PAR "" VERSION "000" ADDR_EPK 0x0 EPK "" SUPPLIER "ETAS GmbH" CUSTOMER "xxx" CUSTOMER_NO "000" USER "xxx" PHONE_NO "000" ECU "PC" CPU_TYPE "PCx86" NO_OF_INTERFACES 1 /end MOD_PAR
/begin MOD_COMMON "Common definitions" BYTE_ORDER MSB_LAST ALIGNMENT_BYTE 1 ALIGNMENT_WORD 2 ALIGNMENT_LONG 4 ALIGNMENT_FLOAT32_IEEE 4 ALIGNMENT_FLOAT64_IEEE 8 /end MOD_COMMON
/begin CHARACTERISTIC myCar.myCar.myDrive_instance.BrakeMomentum "" CURVE 0x0 STANDARD_CURVE_R32R32 0.0 esdl_ident -3.4028234663852886E+38 3.4028234663852886E+38
 /begin AXIS_DESCR STD_AXIS NO_INPUT_QUANTITY esdl_ident 6 -3.4028234663852886E+38 3.4028234663852886E+38 /end AXIS_DESCR
/end CHARACTERISTIC
/begin CHARACTERISTIC myCar.myCar.myDrive_instance.EngineMomentum "" MAP 0x0 STANDARD_MAP_R32R32R32 0.0 esdl_ident -3.4028234663852886E+38 3.4028234663852886E+38
 /begin AXIS_DESCR STD_AXIS NO_INPUT_QUANTITY esdl_ident 6 -3.4028234663852886E+38 3.4028234663852886E+38 /end AXIS_DESCR
 /begin AXIS_DESCR STD_AXIS myCar.myCar.myDrive_instance.v esdl_ident 6 -3.4028234663852886E+38 3.4028234663852886E+38 /end AXIS_DESCR
/end CHARACTERISTIC
/begin CHARACTERISTIC myCar.myCar.myDrive_instance.AirFriction "" CURVE 0x0 STANDARD_CURVE_R32R32 0.0 esdl_ident -3.4028234663852886E+38 3.4028234663852886E+38
 /begin AXIS_DESCR STD_AXIS myCar.myCar.myDrive_instance.v esdl_ident 6 -3.4028234663852886E+38 3.4028234663852886E+38 /end AXIS_DESCR
/end CHARACTERISTIC
/begin CHARACTERISTIC myCar.myCar.myDrive_instance.Landscape "" CURVE 0x0 STANDARD_CURVE_R32R32 0.0 esdl_ident -3.4028234663852886E+38 3.4028234663852886E+38
 /begin AXIS_DESCR STD_AXIS myCar.myCar.myDrive_instance.dist esdl_ident 131 -3.4028234663852886E+38 3.4028234663852886E+38 /end AXIS_DESCR
/end CHARACTERISTIC
/begin MEASUREMENT myCar.myCar.myDrive_instance.h "" FLOAT32_IEEE esdl_ident 1 100.0 -3.4028234663852886E+38 3.4028234663852886E+38 ECU_ADDRESS 0x0 /end MEASUREMENT
/begin MEASUREMENT myCar.myCar.myDrive_instance.dh "" FLOAT32_IEEE esdl_ident 1 100.0 -3.4028234663852886E+38 3.4028234663852886E+38 ECU_ADDRESS 0x0 /end MEASUREMENT
/begin MEASUREMENT myCar.myCar.myDrive_instance.ds "" FLOAT32_IEEE esdl_ident 1 100.0 -3.4028234663852886E+38 3.4028234663852886E+38 ECU_ADDRESS 0x0 /end MEASUREMENT
/begin MEASUREMENT myCar.myCar.myDrive_instance.momentum "" FLOAT32_IEEE esdl_ident 1 100.0 -3.4028234663852886E+38 3.4028234663852886E+38 ECU_ADDRESS 0x0 /end MEASUREMENT
/begin MEASUREMENT myCar.myCar.myDrive_instance.dist "" FLOAT32_IEEE esdl_ident 1 100.0 -3.4028234663852886E+38 3.4028234663852886E+38 ECU_ADDRESS 0x0 /end MEASUREMENT
/begin CHARACTERISTIC myCar.myCar.myDrive_instance.TrackSize "" VALUE 0x0 STANDARD_VALUE_R32 0.0 esdl_ident -3.4028234663852886E+38 3.4028234663852886E+38 /end CHARACTERISTIC
/begin MEASUREMENT myCar.myCar.myDrive_instance.v "" FLOAT32_IEEE esdl_ident 1 100.0 -3.4028234663852886E+38 3.4028234663852886E+38 ECU_ADDRESS 0x0 /end MEASUREMENT
/begin MEASUREMENT myCar.myCar.myDrive_instance.battery "" FLOAT32_IEEE esdl_ident 1 100.0 -3.4028234663852886E+38 3.4028234663852886E+38 ECU_ADDRESS 0x0 /end MEASUREMENT
/begin CHARACTERISTIC myCar.myCar.myDrive_instance.weight "" VALUE 0x0 STANDARD_VALUE_R32 0.0 esdl_ident -3.4028234663852886E+38 3.4028234663852886E+38 /end CHARACTERISTIC
/begin MEASUREMENT myCar.myCar.DetectDecrease_instance.previous "" FLOAT32_IEEE esdl_ident 1 100.0 -3.4028234663852886E+38 3.4028234663852886E+38 ECU_ADDRESS 0x0 /end MEASUREMENT
/begin MEASUREMENT myCar.myCar.DetectDecrease_instance.log "" UBYTE esdl_ident 1 100.0 0 1 ECU_ADDRESS 0x0 BIT_MASK 0x1 /end MEASUREMENT
/begin CHARACTERISTIC myCar.myCar.g "" VALUE 0x0 STANDARD_VALUE_R32 0.0 esdl_ident -3.4028234663852886E+38 3.4028234663852886E+38 /end CHARACTERISTIC
/begin CHARACTERISTIC myCar.myCar.onekm "" VALUE 0x0 STANDARD_VALUE_R32 0.0 esdl_ident -3.4028234663852886E+38 3.4028234663852886E+38 /end CHARACTERISTIC
/begin MEASUREMENT myCar.myCar.dist "" FLOAT32_IEEE esdl_ident 1 100.0 -3.4028234663852886E+38 3.4028234663852886E+38 ECU_ADDRESS 0x0 /end MEASUREMENT
/begin MEASUREMENT myCar.myCar.cycles "" FLOAT32_IEEE esdl_ident 1 100.0 -3.4028234663852886E+38 3.4028234663852886E+38 ECU_ADDRESS 0x0 /end MEASUREMENT
/begin MEASUREMENT resources.CarMessages.v "" UWORD esdl_f0_01_kmh_km2fh 1 100.0 0.0 200.0 ECU_ADDRESS 0x0 /end MEASUREMENT
/begin MEASUREMENT resources.CarMessages.power "" FLOAT32_IEEE esdl_ident 1 100.0 -3.4028234663852886E+38 3.4028234663852886E+38 ECU_ADDRESS 0x0 /end MEASUREMENT
/begin MEASUREMENT resources.CarMessages.brake "" FLOAT32_IEEE esdl_ident 1 100.0 -3.4028234663852886E+38 3.4028234663852886E+38 ECU_ADDRESS 0x0 /end MEASUREMENT
/begin MEASUREMENT resources.CarMessages.recup "" FLOAT32_IEEE esdl_ident 1 100.0 -3.4028234663852886E+38 3.4028234663852886E+38 ECU_ADDRESS 0x0 /end MEASUREMENT
/begin MEASUREMENT resources.CarMessages.battery "" FLOAT32_IEEE esdl_ident 1 100.0 -3.4028234663852886E+38 3.4028234663852886E+38 ECU_ADDRESS 0x0 /end MEASUREMENT
/begin MEASUREMENT resources.CarMessages.x "" FLOAT32_IEEE esdl_ident_m 1 100.0 -3.4028234663852886E+38 3.4028234663852886E+38 ECU_ADDRESS 0x0 /end MEASUREMENT
/begin MEASUREMENT resources.CarMessages.y "" FLOAT32_IEEE esdl_ident_m 1 100.0 -3.4028234663852886E+38 3.4028234663852886E+38 ECU_ADDRESS 0x0 /end MEASUREMENT
/begin MEASUREMENT resources.CarMessages.time "" FLOAT32_IEEE esdl_ident 1 100.0 -3.4028234663852886E+38 3.4028234663852886E+38 ECU_ADDRESS 0x0 /end MEASUREMENT
/begin MEASUREMENT myCar.Driver.EdgeRising_instance.buffer "" UBYTE esdl_ident 1 100.0 0 1 ECU_ADDRESS 0x0 BIT_MASK 0x1 /end MEASUREMENT
/begin MEASUREMENT myCar.Driver.EdgeRising_instance.oldSignal "" UBYTE esdl_ident 1 100.0 0 1 ECU_ADDRESS 0x0 BIT_MASK 0x1 /end MEASUREMENT
/begin MEASUREMENT myCar.Driver.S.timeCounter "" FLOAT64_IEEE esdl_ident 1 100.0 -1.7976931348623157E+308 1.7976931348623157E+308 ECU_ADDRESS 0x0 /end MEASUREMENT
/begin MEASUREMENT myCar.Driver.DriverControl_instance.pow "" FLOAT32_IEEE esdl_ident 1 100.0 -3.4028234663852886E+38 3.4028234663852886E+38 ECU_ADDRESS 0x0 /end MEASUREMENT
/begin MEASUREMENT myCar.Driver.DriverControl_instance.bra "" FLOAT32_IEEE esdl_ident 1 100.0 -3.4028234663852886E+38 3.4028234663852886E+38 ECU_ADDRESS 0x0 /end MEASUREMENT
/begin MEASUREMENT myCar.Driver.DriverControl_instance.on "" UBYTE esdl_ident 1 100.0 0 1 ECU_ADDRESS 0x0 BIT_MASK 0x1 /end MEASUREMENT
/begin MEASUREMENT myCar.Driver.DriverControl_instance.error "" UBYTE esdl_ident 1 100.0 0 1 ECU_ADDRESS 0x0 BIT_MASK 0x1 /end MEASUREMENT
/begin MEASUREMENT myCar.Driver.DriverControl_instance.errtime "" FLOAT32_IEEE esdl_ident 1 100.0 -3.4028234663852886E+38 3.4028234663852886E+38 ECU_ADDRESS 0x0 /end MEASUREMENT
/begin MEASUREMENT myCar.Driver.DriverControl_instance.v "" FLOAT32_IEEE esdl_ident 1 100.0 -3.4028234663852886E+38 3.4028234663852886E+38 ECU_ADDRESS 0x0 /end MEASUREMENT
/begin MEASUREMENT myCar.Driver.DriverControl_instance.dv "" FLOAT32_IEEE esdl_ident 1 100.0 -3.4028234663852886E+38 3.4028234663852886E+38 ECU_ADDRESS 0x0 /end MEASUREMENT
/begin MEASUREMENT myCar.Driver.DriverControlStandardTest_instance.pow "" FLOAT32_IEEE esdl_ident 1 100.0 -3.4028234663852886E+38 3.4028234663852886E+38 ECU_ADDRESS 0x0 /end MEASUREMENT
/begin MEASUREMENT myCar.Driver.DriverControlStandardTest_instance.bra "" FLOAT32_IEEE esdl_ident 1 100.0 -3.4028234663852886E+38 3.4028234663852886E+38 ECU_ADDRESS 0x0 /end MEASUREMENT
/begin MEASUREMENT myCar.Driver.DriverControlStandardTest_instance.on "" UBYTE esdl_ident 1 100.0 0 1 ECU_ADDRESS 0x0 BIT_MASK 0x1 /end MEASUREMENT
/begin MEASUREMENT myCar.Driver.DriverControlStandardTest_instance.strt "" UBYTE esdl_ident 1 100.0 0 1 ECU_ADDRESS 0x0 BIT_MASK 0x1 /end MEASUREMENT
/begin CHARACTERISTIC myCar.Driver.pow "" VALUE 0x0 STANDARD_VALUE_R32 0.0 esdl_ident -3.4028234663852886E+38 3.4028234663852886E+38 /end CHARACTERISTIC
/begin CHARACTERISTIC myCar.Driver.vsoll "" VALUE 0x0 STANDARD_VALUE_R32 0.0 esdl_ident -3.4028234663852886E+38 3.4028234663852886E+38 /end CHARACTERISTIC
/begin CHARACTERISTIC myCar.Driver.driverBrakes "" VALUE 0x0 STANDARD_VALUE_R32 0.0 esdl_ident -3.4028234663852886E+38 3.4028234663852886E+38 /end CHARACTERISTIC
/begin CHARACTERISTIC myCar.Driver.resettime "" VALUE 0x0 STANDARD_VALUE_R32 0.0 esdl_ident -3.4028234663852886E+38 3.4028234663852886E+38 /end CHARACTERISTIC
/begin MEASUREMENT resources.DriverMessages.brake "" FLOAT32_IEEE esdl_ident 1 100.0 -3.4028234663852886E+38 3.4028234663852886E+38 ECU_ADDRESS 0x0 /end MEASUREMENT
/begin MEASUREMENT resources.DriverMessages.power "" FLOAT32_IEEE esdl_ident 1 100.0 -3.4028234663852886E+38 3.4028234663852886E+38 ECU_ADDRESS 0x0 /end MEASUREMENT
/begin MEASUREMENT resources.DriverMessages.on "" UBYTE esdl_ident 1 100.0 0 1 ECU_ADDRESS 0x0 BIT_MASK 0x1 /end MEASUREMENT
/begin MEASUREMENT resources.DriverMessages.display "" UBYTE esdl_ident 1 100.0 0 1 ECU_ADDRESS 0x0 BIT_MASK 0x1 /end MEASUREMENT
/begin MEASUREMENT resources.DriverMessages.increment "" UBYTE esdl_ident 1 100.0 0 1 ECU_ADDRESS 0x0 BIT_MASK 0x1 /end MEASUREMENT
/begin MEASUREMENT resources.DriverMessages.decrement "" UBYTE esdl_ident 1 100.0 0 1 ECU_ADDRESS 0x0 BIT_MASK 0x1 /end MEASUREMENT
/begin MEASUREMENT myCar.CCF.TVI.v "" FLOAT32_IEEE esdl_ident 1 100.0 -3.4028234663852886E+38 3.4028234663852886E+38 ECU_ADDRESS 0x0 /end MEASUREMENT
/begin CHARACTERISTIC myCar.CCF.TVI.dv "" VALUE 0x0 STANDARD_VALUE_R32 0.0 esdl_ident -3.4028234663852886E+38 3.4028234663852886E+38 /end CHARACTERISTIC
/begin CHARACTERISTIC myCar.CCF.TVI.mn "" VALUE 0x0 STANDARD_VALUE_R32 0.0 esdl_ident -3.4028234663852886E+38 3.4028234663852886E+38 /end CHARACTERISTIC
/begin CHARACTERISTIC myCar.CCF.TVI.mx "" VALUE 0x0 STANDARD_VALUE_R32 0.0 esdl_ident -3.4028234663852886E+38 3.4028234663852886E+38 /end CHARACTERISTIC
/begin MEASUREMENT myCar.CCF.OnRising.buffer "" UBYTE esdl_ident 1 100.0 0 1 ECU_ADDRESS 0x0 BIT_MASK 0x1 /end MEASUREMENT
/begin MEASUREMENT myCar.CCF.OnRising.oldSignal "" UBYTE esdl_ident 1 100.0 0 1 ECU_ADDRESS 0x0 BIT_MASK 0x1 /end MEASUREMENT
/begin MEASUREMENT myCar.CCF.PID_instance.inOLD "" FLOAT64_IEEE esdl_ident 1 100.0 -1.7976931348623157E+308 1.7976931348623157E+308 ECU_ADDRESS 0x0 /end MEASUREMENT
/begin MEASUREMENT myCar.CCF.PID_instance.memory1 "" FLOAT64_IEEE esdl_ident 1 100.0 -1.7976931348623157E+308 1.7976931348623157E+308 ECU_ADDRESS 0x0 /end MEASUREMENT
/begin MEASUREMENT myCar.CCF.PID_instance.memory2 "" FLOAT64_IEEE esdl_ident 1 100.0 -1.7976931348623157E+308 1.7976931348623157E+308 ECU_ADDRESS 0x0 /end MEASUREMENT
/begin MEASUREMENT myCar.CCF.IncRising.buffer "" UBYTE esdl_ident 1 100.0 0 1 ECU_ADDRESS 0x0 BIT_MASK 0x1 /end MEASUREMENT
/begin MEASUREMENT myCar.CCF.IncRising.oldSignal "" UBYTE esdl_ident 1 100.0 0 1 ECU_ADDRESS 0x0 BIT_MASK 0x1 /end MEASUREMENT
/begin MEASUREMENT myCar.CCF.DecRising.buffer "" UBYTE esdl_ident 1 100.0 0 1 ECU_ADDRESS 0x0 BIT_MASK 0x1 /end MEASUREMENT
/begin MEASUREMENT myCar.CCF.DecRising.oldSignal "" UBYTE esdl_ident 1 100.0 0 1 ECU_ADDRESS 0x0 BIT_MASK 0x1 /end MEASUREMENT
/begin MEASUREMENT myCar.CCF.SplitSignal_instance.plus "" FLOAT32_IEEE esdl_ident 1 100.0 -3.4028234663852886E+38 3.4028234663852886E+38 ECU_ADDRESS 0x0 /end MEASUREMENT
/begin MEASUREMENT myCar.CCF.SplitSignal_instance.minus "" FLOAT32_IEEE esdl_ident 1 100.0 -3.4028234663852886E+38 3.4028234663852886E+38 ECU_ADDRESS 0x0 /end MEASUREMENT
/begin MEASUREMENT myCar.CCF.CCFS.sm "" UBYTE esdl_myCar_CCFStateStatemachineStates 1 100.0 0 1 ECU_ADDRESS 0x0 /end MEASUREMENT
/begin MEASUREMENT myCar.CCF.CCFS.pow "" FLOAT32_IEEE esdl_ident 1 100.0 -3.4028234663852886E+38 3.4028234663852886E+38 ECU_ADDRESS 0x0 /end MEASUREMENT
/begin MEASUREMENT myCar.CCF.CCFS.bra "" FLOAT32_IEEE esdl_ident 1 100.0 -3.4028234663852886E+38 3.4028234663852886E+38 ECU_ADDRESS 0x0 /end MEASUREMENT
/begin MEASUREMENT myCar.CCF.CCFS.pw "" FLOAT32_IEEE esdl_ident 1 100.0 -3.4028234663852886E+38 3.4028234663852886E+38 ECU_ADDRESS 0x0 /end MEASUREMENT
/begin MEASUREMENT myCar.CCF.CCFS.br "" FLOAT32_IEEE esdl_ident 1 100.0 -3.4028234663852886E+38 3.4028234663852886E+38 ECU_ADDRESS 0x0 /end MEASUREMENT
/begin MEASUREMENT myCar.CCF.CCFS.on "" UBYTE esdl_ident 1 100.0 0 1 ECU_ADDRESS 0x0 BIT_MASK 0x1 /end MEASUREMENT
/begin MEASUREMENT myCar.CCF.CCFS.act "" UBYTE esdl_ident 1 100.0 0 1 ECU_ADDRESS 0x0 BIT_MASK 0x1 /end MEASUREMENT
/begin MEASUREMENT myCar.CCF.CCFS.ctrl "" FLOAT32_IEEE esdl_ident 1 100.0 -3.4028234663852886E+38 3.4028234663852886E+38 ECU_ADDRESS 0x0 /end MEASUREMENT
/begin MEASUREMENT myCar.CCF.vsoll "" FLOAT32_IEEE esdl_ident 1 100.0 -3.4028234663852886E+38 3.4028234663852886E+38 ECU_ADDRESS 0x0 /end MEASUREMENT
/begin CHARACTERISTIC myCar.CCF.K "" VALUE 0x0 STANDARD_VALUE_R32 0.0 esdl_ident -3.4028234663852886E+38 3.4028234663852886E+38 /end CHARACTERISTIC
/begin CHARACTERISTIC myCar.CCF.TV "" VALUE 0x0 STANDARD_VALUE_R32 0.0 esdl_ident -3.4028234663852886E+38 3.4028234663852886E+38 /end CHARACTERISTIC
/begin CHARACTERISTIC myCar.CCF.TN "" VALUE 0x0 STANDARD_VALUE_R32 0.0 esdl_ident -3.4028234663852886E+38 3.4028234663852886E+38 /end CHARACTERISTIC
/begin CHARACTERISTIC myCar.CCF.mn "" VALUE 0x0 STANDARD_VALUE_R32 0.0 esdl_ident -3.4028234663852886E+38 3.4028234663852886E+38 /end CHARACTERISTIC
/begin CHARACTERISTIC myCar.CCF.mx "" VALUE 0x0 STANDARD_VALUE_R32 0.0 esdl_ident -3.4028234663852886E+38 3.4028234663852886E+38 /end CHARACTERISTIC
/begin CHARACTERISTIC myCar.CCF.vs "" VALUE 0x0 STANDARD_VALUE_R32 0.0 esdl_ident -3.4028234663852886E+38 3.4028234663852886E+38 /end CHARACTERISTIC
/begin MEASUREMENT myCar.CCF.ctl "" FLOAT32_IEEE esdl_ident 1 100.0 -3.4028234663852886E+38 3.4028234663852886E+38 ECU_ADDRESS 0x0 /end MEASUREMENT
/begin CHARACTERISTIC myCar.CCF.c "" VALUE 0x0 STANDARD_VALUE_R32 0.0 esdl_ident -3.4028234663852886E+38 3.4028234663852886E+38 /end CHARACTERISTIC
/begin CHARACTERISTIC myCar.CCF.p "" VALUE 0x0 STANDARD_VALUE_R32 0.0 esdl_ident -3.4028234663852886E+38 3.4028234663852886E+38 /end CHARACTERISTIC
/begin CHARACTERISTIC myCar.CCF.withRecup "" VALUE 0x0 STANDARD_VALUE_U8 0.0 esdl_ident 0 1 BIT_MASK 0x1 /end CHARACTERISTIC
/begin MEASUREMENT myCar.CCF.br "" FLOAT32_IEEE esdl_ident 1 100.0 -3.4028234663852886E+38 3.4028234663852886E+38 ECU_ADDRESS 0x0 /end MEASUREMENT
/begin COMPU_METHOD esdl_f0_01_kmh_km2fh "" RAT_FUNC "%12.4" "km/h" COEFFS 0 100 0 0 0 1 /end COMPU_METHOD
/begin COMPU_METHOD esdl_ident "" RAT_FUNC "%12.4" "" COEFFS 0 1 0 0 0 1 /end COMPU_METHOD
/begin COMPU_METHOD esdl_ident_m "" RAT_FUNC "%12.4" "m" COEFFS 0 1 0 0 0 1 /end COMPU_METHOD
/begin COMPU_METHOD esdl_myCar_CCFStateStatemachineStates "" TAB_VERB "%12.4" "" /* compu_tab_ref */ COMPU_TAB_REF esdl_myCar_CCFStateStatemachineStates_vtab /end COMPU_METHOD
/begin COMPU_VTAB esdl_myCar_CCFStateStatemachineStates_vtab "" TAB_VERB /* number value pairs */ 2 /* value pair */ 0 "PassThrough" /* value pair */ 1 "Control" /* default value */ DEFAULT_VALUE "Error" /end COMPU_VTAB
/begin FUNCTION myCar.myCar "" /begin DEF_CHARACTERISTIC myCar.myCar.g myCar.myCar.onekm /end DEF_CHARACTERISTIC
 /begin IN_MEASUREMENT resources.CarMessages.brake resources.CarMessages.power resources.CarMessages.recup /end IN_MEASUREMENT
 /begin OUT_MEASUREMENT resources.CarMessages.battery resources.CarMessages.v resources.CarMessages.x /end OUT_MEASUREMENT
 /begin LOC_MEASUREMENT myCar.myCar.cycles myCar.myCar.dist /end LOC_MEASUREMENT
 /begin SUB_FUNCTION myCar.myCar.DetectDecrease_instance myCar.myCar.myDrive_instance /end SUB_FUNCTION
/end FUNCTION
/begin FUNCTION myCar.myCar.myDrive_instance ""
 /begin DEF_CHARACTERISTIC myCar.myCar.myDrive_instance.BrakeMomentum myCar.myCar.myDrive_instance.EngineMomentum myCar.myCar.myDrive_instance.AirFriction myCar.myCar.myDrive_instance.Landscape myCar.myCar.myDrive_instance.TrackSize myCar.myCar.myDrive_instance.weight /end DEF_CHARACTERISTIC
 /begin LOC_MEASUREMENT myCar.myCar.myDrive_instance.battery myCar.myCar.myDrive_instance.dh myCar.myCar.myDrive_instance.dist myCar.myCar.myDrive_instance.ds myCar.myCar.myDrive_instance.h myCar.myCar.myDrive_instance.momentum myCar.myCar.myDrive_instance.v /end LOC_MEASUREMENT
/end FUNCTION
/begin FUNCTION myCar.myCar.DetectDecrease_instance ""
 /begin LOC_MEASUREMENT myCar.myCar.DetectDecrease_instance.log myCar.myCar.DetectDecrease_instance.previous /end LOC_MEASUREMENT
/end FUNCTION
/begin FUNCTION myCar.Driver ""
 /begin DEF_CHARACTERISTIC myCar.Driver.pow myCar.Driver.vsoll myCar.Driver.driverBrakes myCar.Driver.resettime /end DEF_CHARACTERISTIC
 /begin IN_MEASUREMENT resources.CarMessages.v resources.DriverMessages.display /end IN_MEASUREMENT
 /begin OUT_MEASUREMENT resources.DriverMessages.brake resources.DriverMessages.on resources.DriverMessages.power /end OUT_MEASUREMENT
 /begin SUB_FUNCTION myCar.Driver.DriverControlStandardTest_instance myCar.Driver.DriverControl_instance myCar.Driver.EdgeRising_instance myCar.Driver.RightOpenInterval_instance myCar.Driver.S /end SUB_FUNCTION
/end FUNCTION
/begin FUNCTION myCar.Driver.EdgeRising_instance "EdgeRising detects a rising edge of the logical input signal."
 /begin LOC_MEASUREMENT myCar.Driver.EdgeRising_instance.buffer myCar.Driver.EdgeRising_instance.oldSignal /end LOC_MEASUREMENT
/end FUNCTION
/begin FUNCTION myCar.Driver.S "StopWatch increments the time counter by one dT." /begin LOC_MEASUREMENT myCar.Driver.S.timeCounter /end LOC_MEASUREMENT /end FUNCTION
/begin FUNCTION myCar.Driver.RightOpenInterval_instance "RightOpenInterval returns TRUE if the value x is in the right open interval defined by A and B." /end FUNCTION
/begin FUNCTION myCar.Driver.DriverControl_instance ""
 /begin LOC_MEASUREMENT myCar.Driver.DriverControl_instance.bra myCar.Driver.DriverControl_instance.dv myCar.Driver.DriverControl_instance.error myCar.Driver.DriverControl_instance.errtime myCar.Driver.DriverControl_instance.on myCar.Driver.DriverControl_instance.pow myCar.Driver.DriverControl_instance.v /end LOC_MEASUREMENT
 /begin SUB_FUNCTION myCar.Driver.DriverControl_instance.roi /end SUB_FUNCTION
/end FUNCTION
/begin FUNCTION myCar.Driver.DriverControl_instance.roi "RightOpenInterval returns TRUE if the value x is in the right open interval defined by A and B." /end FUNCTION
/begin FUNCTION myCar.Driver.DriverControlStandardTest_instance ""
 /begin LOC_MEASUREMENT myCar.Driver.DriverControlStandardTest_instance.bra myCar.Driver.DriverControlStandardTest_instance.on myCar.Driver.DriverControlStandardTest_instance.pow myCar.Driver.DriverControlStandardTest_instance.strt /end LOC_MEASUREMENT
/end FUNCTION
/begin FUNCTION myCar.CCF ""
 /begin DEF_CHARACTERISTIC myCar.CCF.K myCar.CCF.TV myCar.CCF.TN myCar.CCF.mn myCar.CCF.mx myCar.CCF.vs myCar.CCF.c myCar.CCF.p myCar.CCF.withRecup /end DEF_CHARACTERISTIC
 /begin IN_MEASUREMENT resources.CarMessages.v resources.DriverMessages.brake resources.DriverMessages.decrement resources.DriverMessages.increment resources.DriverMessages.on resources.DriverMessages.power /end IN_MEASUREMENT
 /begin OUT_MEASUREMENT resources.CarMessages.brake resources.CarMessages.power resources.CarMessages.recup resources.DriverMessages.display /end OUT_MEASUREMENT
 /begin LOC_MEASUREMENT myCar.CCF.br myCar.CCF.ctl myCar.CCF.vsoll /end LOC_MEASUREMENT
 /begin SUB_FUNCTION myCar.CCF.CCFS myCar.CCF.DecRising myCar.CCF.GZ myCar.CCF.IncRising myCar.CCF.Limiter_instance myCar.CCF.OnRising myCar.CCF.PID_instance myCar.CCF.SplitSignal_instance myCar.CCF.TVI /end SUB_FUNCTION
/end FUNCTION
/begin FUNCTION myCar.CCF.TVI "" /begin DEF_CHARACTERISTIC myCar.CCF.TVI.dv myCar.CCF.TVI.mn myCar.CCF.TVI.mx /end DEF_CHARACTERISTIC /begin LOC_MEASUREMENT myCar.CCF.TVI.v /end LOC_MEASUREMENT /end FUNCTION
/begin FUNCTION myCar.CCF.OnRising "EdgeRising detects a rising edge of the logical input signal." /begin LOC_MEASUREMENT myCar.CCF.OnRising.buffer myCar.CCF.OnRising.oldSignal /end LOC_MEASUREMENT /end FUNCTION
/begin FUNCTION myCar.CCF.PID_instance "PID is a time discrete proportional integrator with differential part with time constants TV and TN and gain constant K."
 /begin LOC_MEASUREMENT myCar.CCF.PID_instance.inOLD myCar.CCF.PID_instance.memory1 myCar.CCF.PID_instance.memory2 /end LOC_MEASUREMENT
/end FUNCTION
/begin FUNCTION myCar.CCF.IncRising "EdgeRising detects a rising edge of the logical input signal." /begin LOC_MEASUREMENT myCar.CCF.IncRising.buffer myCar.CCF.IncRising.oldSignal /end LOC_MEASUREMENT /end FUNCTION
/begin FUNCTION myCar.CCF.DecRising "EdgeRising detects a rising edge of the logical input signal." /begin LOC_MEASUREMENT myCar.CCF.DecRising.buffer myCar.CCF.DecRising.oldSignal /end LOC_MEASUREMENT /end FUNCTION
/begin FUNCTION myCar.CCF.GZ "GreaterZero returns TRUE if the value val is greater than zero." /end FUNCTION
/begin FUNCTION myCar.CCF.SplitSignal_instance ""
 /begin LOC_MEASUREMENT myCar.CCF.SplitSignal_instance.minus myCar.CCF.SplitSignal_instance.plus /end LOC_MEASUREMENT
 /begin SUB_FUNCTION myCar.CCF.SplitSignal_instance.GZ /end SUB_FUNCTION
/end FUNCTION
/begin FUNCTION myCar.CCF.SplitSignal_instance.GZ "GreaterZero returns TRUE if the value val is greater than zero." /end FUNCTION
/begin FUNCTION myCar.CCF.CCFS ""
 /begin LOC_MEASUREMENT myCar.CCF.CCFS.act myCar.CCF.CCFS.br myCar.CCF.CCFS.bra myCar.CCF.CCFS.ctrl myCar.CCF.CCFS.on myCar.CCF.CCFS.pow myCar.CCF.CCFS.pw myCar.CCF.CCFS.sm /end LOC_MEASUREMENT
/end FUNCTION
/begin FUNCTION myCar.CCF.Limiter_instance "Limiter returns the input x limited by mn and mx." /end FUNCTION
/begin FUNCTION SystemLib.Miscellaneous.DeltaTimeService "Provides the delta time variable" /end FUNCTION
/begin RECORD_LAYOUT STANDARD_CURVE_R32R32 /* axis size */ NO_AXIS_PTS_X 1 UWORD /* axis */ AXIS_PTS_X 2 FLOAT32_IEEE INDEX_INCR DIRECT FNC_VALUES 3 FLOAT32_IEEE COLUMN_DIR DIRECT /end RECORD_LAYOUT
/begin RECORD_LAYOUT STANDARD_MAP_R32R32R32 /* x axis size */ NO_AXIS_PTS_X 1 UWORD /* y axis size */ NO_AXIS_PTS_Y 2 UWORD /* x axis */ AXIS_PTS_X 3 FLOAT32_IEEE INDEX_INCR DIRECT /* y axis */ AXIS_PTS_Y 4 FLOAT32_IEEE INDEX_INCR DIRECT FNC_VALUES 5 FLOAT32_IEEE COLUMN_DIR DIRECT /end RECORD_LAYOUT
/begin RECORD_LAYOUT STANDARD_VALUE_R32 FNC_VALUES 1 FLOAT32_IEEE COLUMN_DIR DIRECT /end RECORD_LAYOUT
/begin RECORD_LAYOUT STANDARD_VALUE_U8 FNC_VALUES 1 UBYTE COLUMN_DIR DIRECT /end RECORD_LAYOUT
/begin GROUP SystemLib.Miscellaneous.DeltaTimeService "Provides the delta time variable" ROOT /end GROUP
/begin GROUP myCar.CCF "" ROOT
 /begin REF_CHARACTERISTIC myCar.CCF.K myCar.CCF.TV myCar.CCF.TN myCar.CCF.mn myCar.CCF.mx myCar.CCF.vs myCar.CCF.c myCar.CCF.p myCar.CCF.withRecup /end REF_CHARACTERISTIC
 /begin REF_MEASUREMENT myCar.CCF.br myCar.CCF.ctl myCar.CCF.vsoll /end REF_MEASUREMENT
 /begin SUB_GROUP myCar.CCF.CCFS myCar.CCF.DecRising myCar.CCF.GZ myCar.CCF.IncRising myCar.CCF.Limiter_instance myCar.CCF.OnRising myCar.CCF.PID_instance myCar.CCF.SplitSignal_instance myCar.CCF.TVI /end SUB_GROUP
/end GROUP
/begin GROUP myCar.CCF.CCFS ""
 /begin REF_MEASUREMENT myCar.CCF.CCFS.act myCar.CCF.CCFS.br myCar.CCF.CCFS.bra myCar.CCF.CCFS.ctrl myCar.CCF.CCFS.on myCar.CCF.CCFS.pow myCar.CCF.CCFS.pw myCar.CCF.CCFS.sm /end REF_MEASUREMENT
/end GROUP
/begin GROUP myCar.CCF.DecRising "EdgeRising detects a rising edge of the logical input signal." /begin REF_MEASUREMENT myCar.CCF.DecRising.buffer myCar.CCF.DecRising.oldSignal /end REF_MEASUREMENT /end GROUP
/begin GROUP myCar.CCF.GZ "GreaterZero returns TRUE if the value val is greater than zero." /end GROUP
/begin GROUP myCar.CCF.IncRising "EdgeRising detects a rising edge of the logical input signal." /begin REF_MEASUREMENT myCar.CCF.IncRising.buffer myCar.CCF.IncRising.oldSignal /end REF_MEASUREMENT /end GROUP
/begin GROUP myCar.CCF.Limiter_instance "Limiter returns the input x limited by mn and mx." /end GROUP
/begin GROUP myCar.CCF.OnRising "EdgeRising detects a rising edge of the logical input signal." /begin REF_MEASUREMENT myCar.CCF.OnRising.buffer myCar.CCF.OnRising.oldSignal /end REF_MEASUREMENT /end GROUP
/begin GROUP myCar.CCF.PID_instance "PID is a time discrete proportional integrator with differential part with time constants TV and TN and gain constant K."
 /begin REF_MEASUREMENT myCar.CCF.PID_instance.inOLD myCar.CCF.PID_instance.memory1 myCar.CCF.PID_instance.memory2 /end REF_MEASUREMENT
/end GROUP
/begin GROUP myCar.CCF.SplitSignal_instance ""
 /begin REF_MEASUREMENT myCar.CCF.SplitSignal_instance.minus myCar.CCF.SplitSignal_instance.plus /end REF_MEASUREMENT
 /begin SUB_GROUP myCar.CCF.SplitSignal_instance.GZ /end SUB_GROUP
/end GROUP
/begin GROUP myCar.CCF.SplitSignal_instance.GZ "GreaterZero returns TRUE if the value val is greater than zero." /end GROUP
/begin GROUP myCar.CCF.TVI "" /begin REF_CHARACTERISTIC myCar.CCF.TVI.dv myCar.CCF.TVI.mn myCar.CCF.TVI.mx /end REF_CHARACTERISTIC /begin REF_MEASUREMENT myCar.CCF.TVI.v /end REF_MEASUREMENT /end GROUP
/begin GROUP myCar.Driver "" ROOT
 /begin REF_CHARACTERISTIC myCar.Driver.pow myCar.Driver.vsoll myCar.Driver.driverBrakes myCar.Driver.resettime /end REF_CHARACTERISTIC
 /begin SUB_GROUP myCar.Driver.DriverControlStandardTest_instance myCar.Driver.DriverControl_instance myCar.Driver.EdgeRising_instance myCar.Driver.RightOpenInterval_instance myCar.Driver.S /end SUB_GROUP
/end GROUP
/begin GROUP myCar.Driver.DriverControlStandardTest_instance ""
 /begin REF_MEASUREMENT myCar.Driver.DriverControlStandardTest_instance.bra myCar.Driver.DriverControlStandardTest_instance.on myCar.Driver.DriverControlStandardTest_instance.pow myCar.Driver.DriverControlStandardTest_instance.strt /end REF_MEASUREMENT
/end GROUP
/begin GROUP myCar.Driver.DriverControl_instance ""
 /begin REF_MEASUREMENT myCar.Driver.DriverControl_instance.bra myCar.Driver.DriverControl_instance.dv myCar.Driver.DriverControl_instance.error myCar.Driver.DriverControl_instance.errtime myCar.Driver.DriverControl_instance.on myCar.Driver.DriverControl_instance.pow myCar.Driver.DriverControl_instance.v /end REF_MEASUREMENT
 /begin SUB_GROUP myCar.Driver.DriverControl_instance.roi /end SUB_GROUP
/end GROUP
/begin GROUP myCar.Driver.DriverControl_instance.roi "RightOpenInterval returns TRUE if the value x is in the right open interval defined by A and B." /end GROUP
/begin GROUP myCar.Driver.EdgeRising_instance "EdgeRising detects a rising edge of the logical input signal."
 /begin REF_MEASUREMENT myCar.Driver.EdgeRising_instance.buffer myCar.Driver.EdgeRising_instance.oldSignal /end REF_MEASUREMENT
/end GROUP
/begin GROUP myCar.Driver.RightOpenInterval_instance "RightOpenInterval returns TRUE if the value x is in the right open interval defined by A and B." /end GROUP
/begin GROUP myCar.Driver.S "StopWatch increments the time counter by one dT." /begin REF_MEASUREMENT myCar.Driver.S.timeCounter /end REF_MEASUREMENT /end GROUP
/begin GROUP myCar.myCar "" ROOT /begin REF_CHARACTERISTIC myCar.myCar.g myCar.myCar.onekm /end REF_CHARACTERISTIC /begin REF_MEASUREMENT myCar.myCar.cycles myCar.myCar.dist /end REF_MEASUREMENT
 /begin SUB_GROUP myCar.myCar.DetectDecrease_instance myCar.myCar.myDrive_instance /end SUB_GROUP
/end GROUP
/begin GROUP myCar.myCar.DetectDecrease_instance ""
 /begin REF_MEASUREMENT myCar.myCar.DetectDecrease_instance.log myCar.myCar.DetectDecrease_instance.previous /end REF_MEASUREMENT
/end GROUP
/begin GROUP myCar.myCar.myDrive_instance ""
 /begin REF_CHARACTERISTIC myCar.myCar.myDrive_instance.BrakeMomentum myCar.myCar.myDrive_instance.EngineMomentum myCar.myCar.myDrive_instance.AirFriction myCar.myCar.myDrive_instance.Landscape myCar.myCar.myDrive_instance.TrackSize myCar.myCar.myDrive_instance.weight /end REF_CHARACTERISTIC
 /begin REF_MEASUREMENT myCar.myCar.myDrive_instance.battery myCar.myCar.myDrive_instance.dh myCar.myCar.myDrive_instance.dist myCar.myCar.myDrive_instance.ds myCar.myCar.myDrive_instance.h myCar.myCar.myDrive_instance.momentum myCar.myCar.myDrive_instance.v /end REF_MEASUREMENT
/end GROUP
/begin GROUP resources.CarMessages "" ROOT
 /begin REF_MEASUREMENT resources.CarMessages.battery resources.CarMessages.brake resources.CarMessages.power resources.CarMessages.recup resources.CarMessages.time resources.CarMessages.v resources.CarMessages.x resources.CarMessages.y /end REF_MEASUREMENT
/end GROUP
/begin GROUP resources.DriverMessages "" ROOT
 /begin REF_MEASUREMENT resources.DriverMessages.brake resources.DriverMessages.decrement resources.DriverMessages.display resources.DriverMessages.increment resources.DriverMessages.on resources.DriverMessages.power /end REF_MEASUREMENT
/end GROUP
/end MODULE
/end PROJECT
